## kernel/thread/Kconfig
```kconfig
menu "Pthread Options"
	depends on !DISABLE_PTHREAD

config PTHREAD_MUTEX_TYPES
	bool "Enable mutex types"
	default n
	---help---
		Set to enable support for recursive and errorcheck mutexes. Enables
		pthread_mutexattr_settype().

choice
	prompt "pthread mutex robustness"
	default PTHREAD_MUTEX_ROBUST if !DEFAULT_SMALL
	default PTHREAD_MUTEX_UNSAFE if DEFAULT_SMALL

config PTHREAD_MUTEX_ROBUST
	bool "Robust mutexes"
	---help---
		Support only the robust form of the NORMAL mutex.

config PTHREAD_MUTEX_UNSAFE
	bool "Traditional unsafe mutexes"
	---help---
		Support only the traditional non-robust form of the NORMAL mutex.
		You should select this option only for backward compatibility with
		software you may be porting or, perhaps, if you are trying to minimize
		footprint.

config PTHREAD_MUTEX_BOTH
	bool "Both robust and unsafe mutexes"
	---help---
		Support both forms of NORMAL mutexes.

endchoice # pthread mutex robustness

choice
	prompt "Default NORMAL mutex robustness"
	default PTHREAD_MUTEX_DEFAULT_ROBUST
	depends on PTHREAD_MUTEX_BOTH

config PTHREAD_MUTEX_DEFAULT_ROBUST
	bool "Robust default"
	---help---
		The default is robust NORMAL mutexes (non-standard)

config PTHREAD_MUTEX_DEFAULT_UNSAFE
	bool "Unsafe default"
	---help---
		The default is traditional unsafe NORMAL mutexes (standard)

endchoice # Default NORMAL mutex robustness

choice
	prompt "Default pthread mutex protocol"
	default PTHREAD_MUTEX_DEFAULT_PRIO_INHERIT

config PTHREAD_MUTEX_DEFAULT_PRIO_NONE
	bool "PTHREAD_PRIO_NONE default"
	---help---
		By default, pthread mutexes utilize PTHREAD_PRIO_NONE protocol (standard).

config PTHREAD_MUTEX_DEFAULT_PRIO_INHERIT
	bool "PTHREAD_PRIO_INHERIT default"
	depends on PRIORITY_INHERITANCE
	---help---
		By default, pthread mutexes utilize PTHREAD_PRIO_INHERIT protocol
		(POSIX non-standard but a reasonable choice for most real-time systems).

endchoice # Default pthread mutex protocol

config CANCELLATION_POINTS
	bool "Cancellation points"
	default n
	---help---
		Enable POSIX cancellation points for pthread_cancel().  If selected,
		cancellation points will also used with the task_delete() API even if
		pthreads are not enabled.

endmenu # Pthread Options
```

## libs/libc/Kconfig
```kconfig
menu "RTS C Library"

source "libs/libc/fdt/Kconfig"
source "libs/libc/stdio/Kconfig"
source "libs/libc/stdlib/Kconfig"
source "libs/libc/string/Kconfig"
source "libs/libc/unistd/Kconfig"

endmenu
```

## libs/libm/Kconfig
```kconfig
choice
	prompt "RTS Matematical Library"
	default LIBM_NONE if DEFAULT_SMALL
	default LIBM_TOOLCHAIN if !DEFAULT_SMALL

config LIBM
	bool "NuttX"
	depends on !ARCH_MATH_H
	select ARCH_FLOAT_H
	---help---
		By default, no math library will be provided by NuttX.  In this
		case, it is assumed that (1) no math library is required, or (2) you
		will be using the math.h and float.h headers file and the libm
		library provided by your toolchain.

		This is may be a very good choice is possible because your toolchain
		may have have a highly optimized version of libm.

		Another possibility is that you have a custom, architecture-specific
		math library and that the corresponding math.h file resides at
		arch/<architecture>/include/math.h.  The option is selected via
		CONFIG_ARCH_MATH_H.  If ARCH_MATH_H is selected,then the
		include/nuttx/libmath.h header file will be copied to include/math.h
		where it can be used by your applications.

		If ARCH_MATH_H is not defined, then this option can be selected to
		build a generic, math library built into NuttX.  This math library
		comes from the Rhombus OS and was written by Nick Johnson.  The
		Rhombus OS math library port was contributed by Darcy Gong.

config LIBM_NEWLIB
	bool "Newlib"
	depends on !ARCH_MATH_H
	---help---
		Newlib

config LIBM_LIBMCS
	bool "LibmCS"
	depends on !ARCH_MATH_H
	depends on ALLOW_BSD_COMPONENTS
	---help---
		libmcs

config LIBM_OPENLIBM
	bool "openlibm"
	depends on !ARCH_MATH_H
	---help---
		openlibm

config LIBM_TOOLCHAIN
	bool "toolchain"

config LIBM_NONE
	bool "No math library"

endchoice
```

## rt/crypto/Kconfig
```kconfig
menu "RTS RT Crypto"

source "rt/crypto/mbedtls/Kconfig"
source "rt/crypto/nuttx/Kconfig"

endmenu
```

## rt/sched/Kconfig
```kconfig
source "rt/sched/clock/Kconfig"
source "rt/sched/irq/Kconfig"
source "rt/sched/mqueue/Kconfig"
source "rt/sched/pthread/Kconfig"
source "rt/sched/sched/Kconfig"
source "rt/sched/signal/Kconfig"
source "rt/sched/vas/Kconfig"
```
