## Kconfig
```kconfig
mainmenu "Skynet ARM32/ARM64 Real-Time Operating System"

source "hal/Kconfig"
source "kernel/Kconfig"
source "drivers/Kconfig"
source "fs/Kconfig"
source "libs/Kconfig"
source "apps/Kconfig"
```

## apps/Kconfig
```kconfig
comment "Applications:"

source "apps/init/Kconfig"
source "apps/nsh/Kconfig"
source "apps/skynet/Kconfig"
```

## drivers/Kconfig
```kconfig
comment "Device Drivers:"

source "drivers/fdt/Kconfig"
source "drivers/pci/Kconfig"
source "drivers/uart/Kconfig"
source "drivers/eeprom/Kconfig"
source "drivers/i2c/Kconfig"
source "drivers/usbdev/Kconfig"
source "drivers/usbhost/Kconfig"
```

## drivers/fdt/Kconfig
```kconfig
menu "Flat Device Tree"

config DEVICE_TREE
	bool "Device Tree FDT Driver"
	default y
	select LIBC_FDT
	---help---
		Interface for interacting with devicetree.

endmenu
```

## fs/Kconfig
```kconfig
comment "File Systems:"

source "fs/romfs/Kconfig"
source "fs/binfs/Kconfig"
source "fs/vfs/Kconfig"
source "fs/v9fs/Kconfig"

menu "Files and I/O"

config DEV_CONSOLE
	bool "Enable /dev/console"
	default y
	---help---
		Set if architecture-specific logic provides /dev/console at boot-up
		time.  Enables stdout, stderr, stdin in the start-up application.

		You need this setting if your console device is ready at boot time.
		For example, if you are using a serial console, then /dev/console
		(aka, /dev/ttyS0) will be available when the application first starts.

		You must not select DEV_CONSOLE if you console device comes up later
		and is not ready until after the application starts.  At this time,
		the only console device that behaves this way is a USB serial console.
		When the application first starts, the USB is (probably) not yet
		connected and /dev/console will not be created until later when the
		host connects to the USB console.

config FDCLONE_DISABLE
	bool "Disable cloning of file descriptors"
	default n
	---help---
		Disable cloning of all file descriptors by task_create() when a new
		ask is started.  If set, all files/drivers will appear to be closed
		in the new task.

config FDCLONE_STDIO
	bool "Disable clone file descriptors without stdio"
	default n
	---help---
		Disable cloning of all but the first three file descriptors (stdin,
		stdout, stderr) by task_create() when a new task is started. If set,
		all files/drivers will appear to be closed in the new task except
		for stdin, stdout, and stderr.

config NFILE_DESCRIPTORS_PER_BLOCK
	int "The number of file descriptors per block"
	default 8
	range 3 99999
	---help---
		The number of file descriptors per block(one for each open)

config FILE_STREAM
	bool "Enable FILE stream"
	default !DEFAULT_SMALL
	---help---
		Enable the standard buffered input/output support

endmenu # Files and I/O
```

## hal/Kconfig
```kconfig
comment "Hardware Abstraction Layer:"

source "hal/chips/Kconfig"
source "hal/boards/Kconfig"
```

## hal/boards/common/Kconfig
```kconfig
menu "RTS HAL Board Common"
menu "Sony Spresense"
source "hal/boards/common/cxd56xx/src/Kconfig"
endmenu
menu "RP2350"
source "hal/boards/common/rp2350/src/Kconfig"
endmenu
endmenu
```

## hal/boards/cxd56xx/src/Kconfig
```kconfig
config SENSORS_AK09912_SCU
	bool "Asahi AK09911/AK09912 Compass Sensor"
	default n
	depends on !SENSORS_AK09912 && (CXD56_I2C0_SCUSEQ || CXD56_I2C1_SCUSEQ)
	---help---
		Enable driver for AK09911/AK09912 Compass sensor.
		NOTE: This sensor is connected to the SCU unit

config SENSORS_AK09912_SCU_DECI
	bool "AK09912 Magnetometer to decimator"
	default n

config SENSORS_APDS9930_SCU
	bool "Avago APDS9930 Proximity and Ambient light Sensor"
	default n
	depends on CXD56_I2C0_SCUSEQ || CXD56_I2C1_SCUSEQ
	---help---
		Enable driver for APDS9930 proximity and ambient light sensor.

config SENSORS_APDS9930_PROXIMITY_INTERRUPT
	bool "Use Proximity interrupt"
	default n
	---help---
		Use Interrupt when the threshold is exceeded.
		In this case, SCU sequencer is not used.

config SENSORS_BH1721FVC_SCU
	bool "Rohm BH1721FVC Ambient Light Sensor"
	default n
	depends on CXD56_I2C0_SCUSEQ || CXD56_I2C1_SCUSEQ
	---help---
		Enable driver for the Rohm BH1721FVC light sensor.

config SENSORS_BH1745NUC_SCU
	bool "Rohm BH1745NUC Color Sensor"
	default n
	depends on CXD56_I2C0_SCUSEQ || CXD56_I2C1_SCUSEQ
	---help---
		Enable driver for BH1745NUC color sensor.

config SENSORS_BM1383GLV_SCU
	bool "Rohm BM1383GLV/BM1383AGLV Pressure Sensor"
	default n
	depends on CXD56_I2C0_SCUSEQ || CXD56_I2C1_SCUSEQ
	---help---
		Enable driver for BM1383GLV/BM1383AGLV pressure sensor.

config SENSORS_BM1422GMV_SCU
	bool "Rohm BM1422GMV/BM1422AGMV Magnetic Sensor"
	default n
	depends on CXD56_I2C0_SCUSEQ || CXD56_I2C1_SCUSEQ
	---help---
		Enable driver for BM1422GMV/BM1422AGMV magnetic sensor.

choice
	prompt "Slave Address"
	default BM1422GMV_SLAVE_ADDRESS_0F

config BM1422GMV_SLAVE_ADDRESS_0E
	bool "0x0E"

config BM1422GMV_SLAVE_ADDRESS_0F
	bool "0x0F"

endchoice

config SENSORS_BM1422GMV_SCU_DECI
	bool "BM1422GMV Magnetometer to decimator"
	default n

config SENSORS_BMI160_SCU
	bool "Bosch BMI160 Sensor support"
	default n
	depends on !SENSORS_BMI160 && (CXD56_SPI3_SCUSEQ || CXD56_I2C0_SCUSEQ || CXD56_I2C1_SCUSEQ)
	---help---
		Enable driver support for the Bosch BMI160 sensor.

choice
	prompt "BMI160 Interface"
	default SENSORS_BMI160_SCU_SPI

config SENSORS_BMI160_SCU_SPI
	bool "BMI160 SPI Interface"
	depends on CXD56_SPI3_SCUSEQ
	---help---
		Enables support for the SPI interface.

config SENSORS_BMI160_SCU_I2C
	bool "BMI160 I2C Interface"
	depends on CXD56_I2C0_SCUSEQ || CXD56_I2C1_SCUSEQ
	---help---
		Enables support for the I2C interface

endchoice

config SENSORS_BMI160_SCU_DECI_GYRO
	bool "BMI160 Gyroscope to decimator"
	default n

config SENSORS_BMI160_SCU_DECI_ACCEL
	bool "BMI160 Accelerometer to decimator"
	default n

config SENSORS_BMP280_SCU
	bool "Bosch BMP280 Barometric Pressure Sensor"
	default n
	depends on !SENSORS_BMP280 && (CXD56_I2C0_SCUSEQ || CXD56_I2C1_SCUSEQ)
	---help---
		Enable driver for the Bosch BMP280 barometric pressure sensor.


config SENSORS_BMP280_SCU_DECI_PRESS
	bool "BMP280 Pressure to decimator"
	default n

config SENSORS_BMP280_SCU_DECI_TEMP
	bool "BMI280 Temperature to decimator"
	default n


config SENSORS_KX022_SCU
	bool "Kionix KX022/KX122 Acceleration Sensor"
	default n
	depends on CXD56_I2C0_SCUSEQ || CXD56_I2C1_SCUSEQ
	---help---
		Enable driver for the Kionix KX022/KX122 acceleration sensor.

config SENSORS_KX122
	bool "KX122 register compatibility"
	default n
	---help---
		Use KX122 which has the register upper compatibility with KX022.

config SENSORS_KX022_SCU_DECI
	bool "KX022 Accelerometer to decimator"
	default n

config SENSORS_LT1PA01_SCU
	bool "Murata LT1PA01 Proximity and Ambient light Sensor"
	default n
	depends on CXD56_I2C0_SCUSEQ || CXD56_I2C1_SCUSEQ
	---help---
		Enable driver for LT1PA01 proximity and ambient light sensor.

config LT1PA01_PROXIMITY_INTERRUPT
	bool "Use Proximity interrupt"
	default n
	---help---
		Use Interrupt when the threshold is exceeded.
		In this case, SCU sequencer is not used.

config SENSORS_RPR0521RS_SCU
	bool "Rohm RPR0521RS Proximity and Ambient light Sensor"
	default n
	depends on CXD56_I2C0_SCUSEQ || CXD56_I2C1_SCUSEQ
	---help---
		Enable driver for RPR0521RS proximity and ambient light sensor.

config RPR0521RS_PROXIMITY_INTERRUPT
	bool "Use Proximity interrupt"
	default n
	---help---
		Use Interrupt when the threshold is exceeded.
		In this case, SCU sequencer is not used.

config SENSORS_CXD5610_GNSS
	bool "Sony CXD5610 GNSS"
	default n
	---help---
		Enable driver for CXD5610 GNSS device.


config SENSORS_CXD5610_GNSS_SNDBUF_SIZE
	int "CXD5610 GNSS send buffer size"
	default 64

config SENSORS_CXD5610_GNSS_RCVBUF_SIZE
	int "CXD5610 GNSS receive buffer size"
	default 64

config SENSORS_CXD5610_GNSS_NOTIFYBUF_SIZE
	int "CXD5610 GNSS notify buffer size"
	default 1536

config SENSORS_CXD5610_GNSS_NPOLLWAITERS
	int "CXD5610 GNSS max poll waiters"
	default 4

config SENSORS_CXD5610_GNSS_NSIGNALRECEIVERS
	int "CXD5610 GNSS max signal receivers"
	default 4

config SENSORS_CXD5610_GNSS_RX_THREAD_PRIORITY
	int "CXD5610 GNSS receive thread priority"
	default 120

config SENSORS_CXD5610_GNSS_RX_THREAD_STACKSIZE
	int "CXD5610 GNSS receive thread stack size"
	default 1024

config SENSORS_CXD5610_GNSS_UNALIGNED_ACCESS
	bool "Unaligned access"
	default y
	depends on !ENDIAN_BIG
	---help---
		Support unaligned word and half-word access on little endian.

config SENSORS_CXD5610_GNSS_READ_COMPAT
	bool "Compatible with CXD5602 GNSS"
	default y
	---help---
		Support compatible with CXD5602 GNSS
```

## hal/boards/qemu/Kconfig
```kconfig
menu "QEMU Virtio"

choice
	prompt "Qemu Core Configuration"
	default ARCH_CHIP_QEMU_A53

config ARCH_CHIP_QEMU_A53
	bool "Qemu virtual Processor (cortex-a53)"
	select ARCH_HAVE_MULTICPU
	select ARMV8A_HAVE_GICv3
	select ARM64_HAVE_PSCI
	select ARCH_CORTEX_A53

config ARCH_CHIP_QEMU_A57
	bool "Qemu virtual Processor (cortex-a57)"
	select ARCH_HAVE_MULTICPU
	select ARMV8A_HAVE_GICv3
	select ARM64_HAVE_PSCI
	select ARCH_CORTEX_A57

config ARCH_CHIP_QEMU_A72
	bool "Qemu virtual Processor (cortex-a72)"
	select ARCH_HAVE_MULTICPU
	select ARMV8A_HAVE_GICv3
	select ARM64_HAVE_PSCI
	select ARCH_CORTEX_A72

config ARCH_CHIP_QEMU_UNKNOWN
	bool "Qemu virtual Processor (unknown CPU)"
	select ARCH_HAVE_MULTICPU
	select ARMV8A_HAVE_GICv3
	select ARM64_HAVE_PSCI
	select ARCH_CPU_UNKNOWN

endchoice # Qemu Chip Selection

config ARCH_CHIP_QEMU_WITH_HV
	bool "Qemu with hypervisor (e.g. kvm, hvf)"
	default n

endmenu # "Qemu Chip Selection"
```

## hal/boards/specific/Kconfig
```kconfig
menu "RTS HAL Board Specific"
menu "Simulator"
source "hal/boards/specific/sim/Kconfig"
endmenu
endmenu
```

## hal/cores/common/Kconfig
```kconfig
menu "RTS HAL Core Common"
menu "ARMv8-M"
source "hal/cores/common/armv8-m/src/Kconfig"
endmenu
menu "BCM2711"
source "hal/cores/common/bcm2711/src/Kconfig"
endmenu
endmenu
```

## hal/cores/specific/Kconfig
```kconfig
menu "RTS HAL Core Specific"
source "hal/cores/specific/qemu/src/Kconfig"
source "hal/cores/specific/rp2350/src/Kconfig"
endmenu
```

## kernel/Kconfig
```kconfig
comment "Kernel:"

source "kernel/clock/Kconfig"
source "kernel/crypto/Kconfig"
source "kernel/loader/Kconfig"
source "kernel/mem/Kconfig"
source "kernel/sched/Kconfig"
source "kernel/mqueue/Kconfig"
source "kernel/semaphore/Kconfig"
source "kernel/thread/Kconfig"
source "kernel/signal/Kconfig"
source "kernel/task/Kconfig"
```
